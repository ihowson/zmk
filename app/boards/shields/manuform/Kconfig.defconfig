## app/boards/shields/manuform/Kconfig.defconfig
```kconfig
if SHIELD_MANUFORM_LEFT

config ZMK_KEYBOARD_NAME
	default "ManuformIanLeft"

config ZMK_SPLIT_ROLE_CENTRAL
	default y

endif

####################

if SHIELD_MANUFORM_RIGHT

config ZMK_KEYBOARD_NAME
	default "ManuformIanRight"

endif

####################

if SHIELD_MANUFORM_LEFT || SHIELD_MANUFORM_RIGHT
	
config ZMK_SPLIT
	default y

endif
```
